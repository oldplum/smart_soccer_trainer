## common_components/brookesia_system_core/Kconfig
```kconfig
menu "ESP-Brookesia - System Core Configurations"
    menu "Base"
        menuconfig ESP_BROOKESIA_BASE_ENABLE_DEBUG_LOG
            bool "Enable debug log output"
            depends on ESP_UTILS_CONF_LOG_LEVEL_DEBUG
            default y

        if ESP_BROOKESIA_BASE_ENABLE_DEBUG_LOG
            config ESP_BROOKESIA_BASE_APP_ENABLE_DEBUG_LOG
                bool "App"
                default y

            config ESP_BROOKESIA_BASE_DISPLAY_ENABLE_DEBUG_LOG
                bool "Display"
                default y

            config ESP_BROOKESIA_BASE_EVENT_ENABLE_DEBUG_LOG
                bool "Event"
                default y

            config ESP_BROOKESIA_BASE_MANAGER_ENABLE_DEBUG_LOG
                bool "Manager"
                default y

            config ESP_BROOKESIA_BASE_CONTEXT_ENABLE_DEBUG_LOG
                bool "Context"
                default y
        endif
    endmenu

    menu "GUI"
        menu "LVGL"
            menuconfig ESP_BROOKESIA_LVGL_ENABLE_DEBUG_LOG
                bool "Enable debug log output"
                depends on ESP_UTILS_CONF_LOG_LEVEL_DEBUG
                default y

            if ESP_BROOKESIA_LVGL_ENABLE_DEBUG_LOG
                config ESP_BROOKESIA_LVGL_ANIMATION_ENABLE_DEBUG_LOG
                    bool "Animation"
                    depends on ESP_UTILS_CONF_LOG_LEVEL_DEBUG
                    default y

                config ESP_BROOKESIA_LVGL_CANVAS_ENABLE_DEBUG_LOG
                    bool "Canvas"
                    depends on ESP_UTILS_CONF_LOG_LEVEL_DEBUG
                    default y

                config ESP_BROOKESIA_LVGL_CONTAINER_ENABLE_DEBUG_LOG
                    bool "Container"
                    depends on ESP_UTILS_CONF_LOG_LEVEL_DEBUG
                    default y

                config ESP_BROOKESIA_LVGL_DISPLAY_ENABLE_DEBUG_LOG
                    bool "Display"
                    depends on ESP_UTILS_CONF_LOG_LEVEL_DEBUG
                    default y

                config ESP_BROOKESIA_LVGL_HELPER_ENABLE_DEBUG_LOG
                    bool "Helper"
                    depends on ESP_UTILS_CONF_LOG_LEVEL_DEBUG
                    default y

                config ESP_BROOKESIA_LVGL_LOCK_ENABLE_DEBUG_LOG
                    bool "Lock"
                    depends on ESP_UTILS_CONF_LOG_LEVEL_DEBUG
                    default y

                config ESP_BROOKESIA_LVGL_OBJECT_ENABLE_DEBUG_LOG
                    bool "Object"
                    depends on ESP_UTILS_CONF_LOG_LEVEL_DEBUG
                    default y

                config ESP_BROOKESIA_LVGL_SCREEN_ENABLE_DEBUG_LOG
                    bool "Screen"
                    depends on ESP_UTILS_CONF_LOG_LEVEL_DEBUG
                    default y

                config ESP_BROOKESIA_LVGL_TIMER_ENABLE_DEBUG_LOG
                    bool "Timer"
                    depends on ESP_UTILS_CONF_LOG_LEVEL_DEBUG
                    default y
            endif
        endmenu

        menuconfig ESP_BROOKESIA_GUI_ENABLE_SQUARELINE
            bool "Squareline Helpers"
            default y

        if ESP_BROOKESIA_GUI_ENABLE_SQUARELINE
            config ESP_BROOKESIA_SQUARELINE_ENABLE_UI_COMP
                bool "Use UI component from inside"
                default y

            config ESP_BROOKESIA_SQUARELINE_ENABLE_UI_HELPERS
                bool "Use UI helpers from inside"
                default y
        endif

        menu "Style"
            config ESP_BROOKESIA_STYLE_ENABLE_DEBUG_LOG
                bool "Enable debug log output"
                depends on ESP_UTILS_CONF_LOG_LEVEL_DEBUG
                default y
        endmenu
    endmenu
endmenu
```

## common_components/brookesia_system_phone/Kconfig
```kconfig
menu "ESP-Brookesia - System Phone Configurations"
    menuconfig ESP_BROOKESIA_PHONE_ENABLE_DEBUG_LOG
        bool "Enable debug log output"
        depends on ESP_UTILS_CONF_LOG_LEVEL_DEBUG
        default y

    if ESP_BROOKESIA_PHONE_ENABLE_DEBUG_LOG
        config ESP_BROOKESIA_PHONE_APP_ENABLE_DEBUG_LOG
            bool "App"
            default y

        config ESP_BROOKESIA_PHONE_HONE_ENABLE_DEBUG_LOG
            bool "Display"
            default y

        config ESP_BROOKESIA_PHONE_MANAGER_ENABLE_DEBUG_LOG
            bool "Manager"
            default y

        config ESP_BROOKESIA_PHONE_PHONE_ENABLE_DEBUG_LOG
            bool "Phone"
            default y

        menu "Widgets"
            config ESP_BROOKESIA_PHONE_APP_LAUNCHER_ENABLE_DEBUG_LOG
                bool "App launcher"
                default y

            config ESP_BROOKESIA_PHONE_GESTURE_ENABLE_DEBUG_LOG
                bool "Gesture"
                default y

            config ESP_BROOKESIA_PHONE_NAVIGATION_BAR_ENABLE_DEBUG_LOG
                bool "Navigation bar"
                default y

            config ESP_BROOKESIA_PHONE_RECENTS_SCREEN_ENABLE_DEBUG_LOG
                bool "Recents screen"
                default y

            config ESP_BROOKESIA_PHONE_STATUS_BAR_ENABLE_DEBUG_LOG
                bool "Status bar"
                default y
        endmenu
    endif
endmenu
```
